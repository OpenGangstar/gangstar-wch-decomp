SECTIONS {
 .renderfx_set_member_value 0x003eea48 : { *renderfx-animation.o(.text._ZN8RenderFX9SetMemberEPKcS1_RN7gameswf8as_valueE) }
 ASSERT(SIZEOF(.renderfx_set_member_value) == 200, "native SetMember value strict span")
}
